## boards/arm/uwu30/Kconfig.defconfig
```kconfig
# Copyright (c) 2023 The ZMK Contributors
# SPDX-License-Identifier: MIT

if BOARD_UWU30

config ZMK_KEYBOARD_NAME
    default "uwu30"

if USB

config USB_NRFX
    default y

config USB_DEVICE_STACK
    default y

endif # USB

config BT_CTLR
    default BT

endif # BOARD_UWU30
```

## config/boards/arm/uwu30/Kconfig.board
```kconfig
# Copyright (c) 2020 The ZMK Contributors
# SPDX-License-Identifier: MIT

config BOARD_UWU30
	bool "uwu30"
	depends on SOC_NRF52840_QIAA
```
